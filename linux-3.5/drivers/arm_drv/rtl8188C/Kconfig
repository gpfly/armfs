## linux-3.5/drivers/arm_drv/rtl8188C/Kconfig
```kconfig
config RTL8192CU
	tristate "Realtek 8192C USB WiFi 20161012"
	depends on USB
	---help---
	  Help message of RTL8192CU
```

## linux-3.5/drivers/arm_drv/wdt/Kconfig
```kconfig
config WDT_DRV
	tristate "Char driver for 4412 WDT"
	help
	  xxx

config SUPPORT_RESET
	bool "watchdog support hardware reset"
	help
	  support reset or interrupt

config WDT_TIME
	int "Default watchdog timeout"
	default "10"
	help
	  xxx
```

## linux-3.5/drivers/myarm_drv/Kconfig
```kconfig
menuconfig UPLOOKING_DRIVER
	bool "class 160615 device driver"
	---help---
	 this class start to learn kernel driver at 9-18

comment "kiss the rain..."

if UPLOOKING_DRIVER

menu "the keywords for type"

config MILLET_LED
	tristate 
	prompt "4led driver on tiny4412"
	---help---
	 about 4 leds driver

config MILLET_INFO
	string "debug info prefix"
	---help---
	 just a string

config MILLET_NUM
	int "how many do you want to turn on led"
	range 1 4
	---help---
	 just a number
endmenu

menu "the other keywords, select/choice/depends on"

config MAIXIGUA
	bool "buy xigua for select"
	select BANGMANG
	---help---
	 nothing

config BANGMANG 
	bool "help xx to take xigua"
	---help---
	 nothing

choice 
	prompt "choose a driver for memory device"

config KMEM_DRV1
	tristate 
	prompt "kernel memory device driver 1"
	---help---
	 nothing

config KMEM_DRV2
	tristate "kernel memory device driver 2"
	---help---
	 nothing

endchoice

config MYIIC 
	tristate "IIC control driver"
	default y
	---help---
	 nothing

config FT5206XX
	tristate "ft5206 ctp driver"
	depends on MYIIC
	---help---
	 nothing
	

endmenu

endif

#menuconfig/config
#if/endif  
#bool/tristate/hex/int/string
#---help---/help
#prompt/comment
#choice/depends on/select
#menu/endmenu
#default/range
```
